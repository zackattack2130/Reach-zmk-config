/* SPDX-License-Identifier: MIT */
#include "reach.dtsi"

/* Right half: 6 columns; rows are in reach.dtsi */
&kscan0 {
    col-gpios = <&pro_micro 6  GPIO_ACTIVE_HIGH>,
                <&pro_micro 5  GPIO_ACTIVE_HIGH>,
                <&pro_micro 4  GPIO_ACTIVE_HIGH>,
                <&pro_micro 0  GPIO_ACTIVE_HIGH>,
                <&pro_micro 22 GPIO_ACTIVE_HIGH>,
                <&pro_micro 23 GPIO_ACTIVE_HIGH>;
};

/* Positions on the right start after the left's 6 columns */
&default_transform { col-offset = <6>; };
