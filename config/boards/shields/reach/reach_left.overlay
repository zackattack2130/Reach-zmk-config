/* SPDX-License-Identifier: MIT */
#include "reach.dtsi"

/* Left half: 6 columns; rows are in reach.dtsi */
&kscan0 {
    col-gpios = <&pro_micro 16 GPIO_ACTIVE_HIGH>,
                <&pro_micro 14 GPIO_ACTIVE_HIGH>,
                <&pro_micro 10 GPIO_ACTIVE_HIGH>,
                <&pro_micro 9  GPIO_ACTIVE_HIGH>,
                <&pro_micro 8  GPIO_ACTIVE_HIGH>,
                <&pro_micro 7  GPIO_ACTIVE_HIGH>;
};