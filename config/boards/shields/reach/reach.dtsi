/* SPDX-License-Identifier: MIT */
/* Shared settings for both halves of the Reach handwired Lily58-style split */
#include <dt-bindings/zmk/matrix_transform.h>

/ {
    kscan0: kscan0 {
        compatible = "zmk,kscan-gpio-matrix";
        diode-direction = "col2row";
        wakeup-source;

        /* 5 rows, same on both halves (hand-wired) */
        row-gpios = <&pro_micro 18 (GPIO_ACTIVE_HIGH | GPIO_PULL_DOWN)>,
                    <&pro_micro 19 (GPIO_ACTIVE_HIGH | GPIO_PULL_DOWN)>,
                    <&pro_micro 20 (GPIO_ACTIVE_HIGH | GPIO_PULL_DOWN)>,
                    <&pro_micro 21 (GPIO_ACTIVE_HIGH | GPIO_PULL_DOWN)>,
                    <&pro_micro 15 (GPIO_ACTIVE_HIGH | GPIO_PULL_DOWN)>;
    };

    /* Logical matrix: 5 rows x 6 columns per half */
    default_transform: keymap_transform0 {
        compatible = "zmk,matrix-transform";
        rows = <5>;
        columns = <6>;
        /* Default row-major order; we can customize later if needed */
    };
};